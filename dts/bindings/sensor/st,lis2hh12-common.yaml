## dts/bindings/sensor/st,lis2hh12-common.yaml
```yaml
# Copyright (c) 2021 STMicroelectronics
# SPDX-License-Identifier: Apache-2.0

include: sensor-device.yaml

properties:
  irq-gpios:
    type: phandle-array
    description: |
      DRDY pin

      This pin defaults to active high when produced by the sensor.
      The property value should ensure the flags properly describe
      the signal that is presented to the driver.

  range:
    type: int
    default: 8
    description: |
      Range in g. Default is 8g configuration.

    enum:
      - 8  #  8g (0.244 mg/LSB)
      - 4  #  4g (0.122 mg/LSB)
      - 2  #  2g (0.061 mg/LSB)

  odr:
    type: int
    default: 6
    description: |
        Specify the default output data rate expressed in samples per second (Hz).
        Default is power-down mode
    enum:
      - 0 # OFF
      - 1 # 10Hz
      - 2 # 50Hz
      - 3 # 100Hz
      - 4 # 200Hz
      - 5 # 400Hz
      - 6 # 800Hz
```

## dts/bindings/sensor/st,lis2hh12-i2c.yaml
```yaml
# Copyright (c) 2019 STMicroelectronics
# SPDX-License-Identifier: Apache-2.0

description: STMicroelectronics LIS2HH12 3-axis accelerometer

compatible: "st,lis2hh12"

include: ["i2c-device.yaml", "st,lis2hh12-common.yaml"]
```

## dts/bindings/sensor/st,lis2hh12-spi.yaml
```yaml
# Copyright (c) 2019 STMicroelectronics
# SPDX-License-Identifier: Apache-2.0

description: |
    STMicroelectronics LIS2HH12 3-axis accelerometer accessed through SPI bus

compatible: "st,lis2hh12"

include: ["spi-device.yaml", "st,lis2hh12-common.yaml"]
```
